#include <M5StickCPlus.h>

void setup() {
  M5.begin();
  M5.Lcd.fillScreen(LIGHTGREY); // 背景をLIGHTGRAYに設定
}

void loop() {
  // ドットパターン1
  uint8_t pattern1[12][12] = {
    {0, 0, 0, 0, 0, 0, 0, 0, 0, 0, 0, 0},
    {0, 0, 0, 0, 1, 1, 1, 1, 1, 0, 0, 0},
    {0, 0, 0, 1, 0, 0, 0, 0, 0, 1, 0, 0},
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    {0, 0, 0, 0, 1, 1, 1, 1, 1, 1, 0, 0}
  };

  // ドットパターン2
  uint8_t pattern2[12][12] = {
    {0, 0, 0, 0, 0, 0, 0, 0, 0, 0, 0, 0},
    {0, 0, 0, 0, 0, 0, 0, 0, 0, 0, 0, 0},
    {0, 0, 0, 0, 1, 1, 1, 1, 1, 0, 0, 0},
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    {0, 0, 0, 0, 1, 1, 1, 1, 1, 1, 0, 0}
  };

  uint16_t size = 10;      // 1ドットのサイズ
  uint16_t centerX = 67;    // 描画開始X座標
  uint16_t centerY = 120;    // 描画開始Y座標

  // ドット絵の左上基準座標
  uint16_t startX = centerX - (12 * size) / 2;
  uint16_t startY = centerY - (12 * size) / 2;

  // パターン1を描画
  for (uint16_t i = 0; i < 12; i++) {
    for (uint16_t j = 0; j < 12; j++) {
      uint16_t color = (pattern1[i][j] == 1) ? BLACK : LIGHTGREY;
      M5.Lcd.fillRect(startX + j * size, startY + i * size, size, size, color);
    }
  }

  delay(500);

  // パターン2を描画
  for (uint16_t i = 0; i < 12; i++) {
    for (uint16_t j = 0; j < 12; j++) {
      uint16_t color = (pattern2[i][j] == 1) ? BLACK : LIGHTGREY;
      M5.Lcd.fillRect(startX + j * size, startY + i * size, size, size, color);
    }
  }

  delay(500);
}
